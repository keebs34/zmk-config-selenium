#ifndef SLN_BASE_LAYER
#define SLN_BASE_LAYER(name, LOUT1,  LROW1,  RROW1,  ROUT1, \
                             LOUT2,  LROW2,  RROW2,  ROUT2, \
                             LOUT3,  LROW3,  RROW3,  ROUT3, \
                             LT1, LT2, LT3,  RT3, RT2, RT1) \
    SLN_LAYER(name,                                                                               \
        &kp F1    &kp F2 &kp F3 &kp F4 &kp F5               &kp F6 &kp F7 &kp F8 &kp F9 &kp F10   \
        &kp EQUAL &kp N1 &kp N2 &kp N3 &kp N4 &kp N5 &kp N6 &kp N7 &kp N8 &kp N9 &kp N0 &kp MINUS \
        LOUT1     LROW1                                                          RROW1  ROUT1     \
        LOUT2     LROW2                                                          RROW2  ROUT2     \
        LOUT3     LROW3         &none  &none  &none  &none  &none  &none         RROW3  ROUT3     \
        &kp LEFT  &kp RIGHT  LT1  LT2  LT3    &none  &none        RT3  RT2  RT1  &kp UP &kp DOWN  \
                                                     &none  &none  &none)
#endif

#include "../include/selenium/selenium.keymap"
