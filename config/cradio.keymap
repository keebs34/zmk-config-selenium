// A firmware for a few 34 key keyboards, including Cradio, Hypergolic and Sweep.

#define SELENIUM_KEYMAP_BINDINGS(LOUT1,  LROW1,  RROW1,  ROUT1, \
                                 LOUT2,  LROW2,  RROW2,  ROUT2, \
                                 LOUT3,  LROW3,  RROW3,  ROUT3, \
                                 LT1, LT2, LT3,  RT3, RT2, RT1) \
      LROW1   RROW1 \
      LROW2   RROW2 \
      LROW3   RROW3 \
    LT1 LT2   RT2 RT1

// This keyboard has only two keys per thumb.
// Ensure the 2TK flavor is selected.
#define FORCE_HT_TWO_THUMB_KEYS

#include "../include/selenium/selenium.keymap"
